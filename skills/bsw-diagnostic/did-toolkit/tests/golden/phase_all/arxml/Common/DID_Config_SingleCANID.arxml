AUTOSAR XML (schema 00048)
package /RB/UBK/Project/EcucModuleConfigurationValuess
  module config Dcm
    DcmConfigSet
      DcmDsp
        5 x DcmDspData, all with DcmDspDataEndianness=BIG_ENDIAN, DcmDspDataType=UINT8_N, DcmDspDataUsePort=USE_DATA_SYNCH_FNC:
          RBAPLCUST_F18C_ModeSelectorData: DcmDspDataReadFnc=RBAPLCUST_F18C_ModeSelector_ReadData, DcmDspDataSize=8, DcmDspDataWriteFnc=RBAPLCUST_F18C_ModeSelector_WriteData
          RBAPLCUST_F190_BaselineCounterData: DcmDspDataReadFnc=RBAPLCUST_F190_BaselineCounter_ReadData, DcmDspDataSize=8
          RBAPLCUST_F1A0_LiveTemperatureData: DcmDspDataReadFnc=RBAPLCUST_F1A0_LiveTemperature_ReadData, DcmDspDataSize=8
          RBAPLCUST_F1A1_CalibrationConstantData: DcmDspDataReadFnc=RBAPLCUST_F1A1_CalibrationConstant_ReadData, DcmDspDataSize=8, DcmDspDataWriteFnc=RBAPLCUST_F1A1_CalibrationConstant_WriteData
          RBAPLCUST_F1A2_RegionCodeData: DcmDspDataReadFnc=RBAPLCUST_F1A2_RegionCode_ReadData, DcmDspDataSize=16
        DcmDspDidInfo_Read (DcmDspDidInfo): DcmDspDidDynamicallyDefined=false
          DcmDspDidRead
        DcmDspDidInfo_ReadAndWrite (DcmDspDidInfo): DcmDspDidDynamicallyDefined=false
          DcmDspDidWrite: DcmDspDidWriteSessionRef=EXTENDED_DIAGNOSTIC_SESSION, DcmDspDidWriteSecurityLevelRef=DCM_SEC_LEV_L1
          DcmDspDidRead
        5 x DcmDspDid, all with DcmDspDidUsePort=USE_DATA_ELEMENT_SPECIFIC_INTERFACES, DcmRbAtomicSenderReceiverCommunication=false:
          RBAPLCUST_F18C_ModeSelectorDataDid: DcmDspDidIdentifier=61836, DcmDspDidInfoRef=DcmDspDidInfo_ReadAndWrite
            DcmDspDidSignal_0 (DcmDspDidSignal): DcmDspDidDataPos=0, DcmDspDidDataRef=RBAPLCUST_F18C_ModeSelectorData
          RBAPLCUST_F190_BaselineCounterDataDid: DcmDspDidIdentifier=61840, DcmDspDidInfoRef=DcmDspDidInfo_Read
            DcmDspDidSignal_0 (DcmDspDidSignal): DcmDspDidDataPos=0, DcmDspDidDataRef=RBAPLCUST_F190_BaselineCounterData
          RBAPLCUST_F1A0_LiveTemperatureDataDid: DcmDspDidIdentifier=61856, DcmDspDidInfoRef=DcmDspDidInfo_Read
            DcmDspDidSignal_0 (DcmDspDidSignal): DcmDspDidDataPos=0, DcmDspDidDataRef=RBAPLCUST_F1A0_LiveTemperatureData
          RBAPLCUST_F1A1_CalibrationConstantDataDid: DcmDspDidIdentifier=61857, DcmDspDidInfoRef=DcmDspDidInfo_ReadAndWrite
            DcmDspDidSignal_0 (DcmDspDidSignal): DcmDspDidDataPos=0, DcmDspDidDataRef=RBAPLCUST_F1A1_CalibrationConstantData
          RBAPLCUST_F1A2_RegionCodeDataDid: DcmDspDidIdentifier=61858, DcmDspDidInfoRef=DcmDspDidInfo_Read
            DcmDspDidSignal_0 (DcmDspDidSignal): DcmDspDidDataPos=0, DcmDspDidDataRef=RBAPLCUST_F1A2_RegionCodeData
