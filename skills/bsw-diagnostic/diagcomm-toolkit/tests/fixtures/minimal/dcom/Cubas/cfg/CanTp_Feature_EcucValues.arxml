AUTOSAR XML (schema 4.0)
package /CanTp_Feature
  module config CanTp
    CanTpGeneral (): CanTpFlexibleDataRateSupport=false, CanTpPaddingByte=0, CanTpRbStrictDlcCheck=false
