AUTOSAR XML (schema 4.0)
package /Dcm_Feature
  module config Dcm
    DcmConfigSet ()
      DcmDsl ()
        DcmDslDiagResp (): DcmDslDiagRespMaxNumRespPend=3
