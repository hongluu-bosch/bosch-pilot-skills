AUTOSAR XML (schema 4.0)
package /CanTp_CusDiag
  module config CanTp
    CanTpGlobalConfig (): CanTpAddressingFormat=CANTP_STANDARD
      CanTpChannel_0 (CanTpChannel)
        CanTpTxNSdu_CusDiagPhy (CanTpTxNSdu): CanTpNas=0.07, CanTpNbs=0.15, CanTpNcs=0.1
        CanTpRxNSdu_CusDiagPhy (CanTpRxNSdu): CanTpNar=0.07, CanTpNbr=0.025, CanTpNcr=0.15, CanTpBs=0, CanTpSTmin=0.02
