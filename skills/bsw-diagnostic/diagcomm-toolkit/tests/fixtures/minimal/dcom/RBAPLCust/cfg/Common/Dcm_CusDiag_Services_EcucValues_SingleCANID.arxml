AUTOSAR XML (schema 4.0)
package /Dcm_CusDiag_Services
  module config Dcm
    DcmDspSession ()
      3 x , all with DcmDspSessionP2ServerMax=0.05, DcmDspSessionP2StarServerMax=5.0:
        DcmDspSessionRow_Default
        DcmDspSessionRow_Extended
        DcmDspSessionRow_Programming
