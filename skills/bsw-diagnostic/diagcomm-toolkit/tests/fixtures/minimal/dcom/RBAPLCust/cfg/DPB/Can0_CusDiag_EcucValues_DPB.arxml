AUTOSAR XML (schema 4.0)
package /Can0_CusDiag
  module config Can
    CanConfigSet ()
      CanController_0 ()
        3 x , all with CanIdType=STANDARD:
          CusDiagRCVFunc
            CanHwFilter_0 (): CanHwFilterCode=0
          CusDiagRCV
            CanHwFilter_0 (): CanHwFilterCode=0
          CusDiagXMT
            CanHwFilter_0 (): CanHwFilterCode=0
  module config CanIf
    CanIfInitCfg ()
      3 x :
        CusDiagRCVFunc: CanIfRxPduCanId=0, CanIfRxPduCanIdType=STANDARD_CAN
        CusDiagRCV: CanIfRxPduCanId=0, CanIfRxPduCanIdType=STANDARD_CAN
        CusDiagXMT: CanIfTxPduCanId=0, CanIfTxPduCanIdType=STANDARD_CAN
  module config EcuC
    EcucPduCollection ()
      3 x , all with PduLength=8:
        CusDiagRCVFunc_Pdu
        CusDiagRCV_Pdu
        CusDiagXMT_Pdu
